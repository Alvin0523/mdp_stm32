/**
 * @file oled.c
 * @brief SSD1306 0.96" OLED Driver Implementation with Bezel Calibration Test Page
 */

#include "oled.h"
#include <stdio.h>
#include <string.h>

uint8_t g_oled_page = 0;

/* Hardware Pin Assignments for WHEELTEC C30D Board */
#define OLED_SCLK_0() HAL_GPIO_WritePin(GPIOD, GPIO_PIN_14, GPIO_PIN_RESET)
#define OLED_SCLK_1() HAL_GPIO_WritePin(GPIOD, GPIO_PIN_14, GPIO_PIN_SET)

#define OLED_SDIN_0() HAL_GPIO_WritePin(GPIOD, GPIO_PIN_13, GPIO_PIN_RESET)
#define OLED_SDIN_1() HAL_GPIO_WritePin(GPIOD, GPIO_PIN_13, GPIO_PIN_SET)

#define OLED_RST_0()  HAL_GPIO_WritePin(GPIOD, GPIO_PIN_12, GPIO_PIN_RESET)
#define OLED_RST_1()  HAL_GPIO_WritePin(GPIOD, GPIO_PIN_12, GPIO_PIN_SET)

#define OLED_DC_0()   HAL_GPIO_WritePin(GPIOD, GPIO_PIN_11, GPIO_PIN_RESET)
#define OLED_DC_1()   HAL_GPIO_WritePin(GPIOD, GPIO_PIN_11, GPIO_PIN_SET)

/* Crisp 8x16 Standard ASCII Font Table */
static const uint8_t g_asc2_1608[95][16] = {
    {0x00,0x00,0x00,0x00,0x00,0x00,0x00,0x00,0x00,0x00,0x00,0x00,0x00,0x00,0x00,0x00}, /* " " */
    {0x00,0x00,0x00,0xF8,0x00,0x00,0x00,0x00,0x00,0x00,0x00,0x27,0x00,0x00,0x00,0x00}, /* "!" */
    {0x00,0x08,0x04,0x02,0x00,0x08,0x04,0x02,0x00,0x00,0x00,0x00,0x00,0x00,0x00,0x00}, /* """ */
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    {0x00,0x08,0x08,0x88,0x48,0x38,0x08,0x00,0x00,0x20,0x30,0x28,0x24,0x22,0x21,0x00}, /* "Z" */

    /* Only space through 'Z' were ever defined above (59 of the declared 95
     * entries) - everything past 'Z' silently zero-initializes to a BLANK
     * glyph. That includes every lowercase letter, which is why "cm" (the
     * unit suffix on page 2's Ultra/IR lines) was rendering as literally
     * invisible. Adding just the two characters actually in use via
     * designated initializers, rather than filling in the entire unused
     * '['-'~' range this table was never populated for. */
    [67] = {0x00,0x80,0x40,0x40,0x40,0x80,0x00,0x00,0x00,0x07,0x08,0x08,0x08,0x04,0x00,0x00}, /* "c" */
    [77] = {0xC0,0x40,0x80,0x40,0xC0,0x00,0x00,0x00,0x07,0x00,0x07,0x00,0x07,0x00,0x00,0x00}, /* "m" */
};

static void oled_write_byte(uint8_t dat, uint8_t cmd)
{
    if (cmd)
        OLED_DC_1();
    else
        OLED_DC_0();

    for (uint8_t i = 0; i < 8; i++) {
        OLED_SCLK_0();
        if (dat & 0x80)
            OLED_SDIN_1();
        else
            OLED_SDIN_0();
        OLED_SCLK_1();
        dat <<= 1;
    }
}

static void oled_set_pos(uint8_t x, uint8_t y)
{
    oled_write_byte(0xb0 + y, 0);
    oled_write_byte(((x & 0xf0) >> 4) | 0x10, 0);
    oled_write_byte((x & 0x0f), 0);
}

void oled_clear(void)
{
    for (uint8_t i = 0; i < 8; i++) {
        oled_set_pos(0, i);
        for (uint8_t n = 0; n < 128; n++) {
            oled_write_byte(0x00, 1);
        }
    }
}

void oled_init(void)
{
    __HAL_RCC_GPIOD_CLK_ENABLE();

    GPIO_InitTypeDef GPIO_InitStruct = {0};
    GPIO_InitStruct.Pin = GPIO_PIN_11 | GPIO_PIN_12 | GPIO_PIN_13 | GPIO_PIN_14;
    GPIO_InitStruct.Mode = GPIO_MODE_OUTPUT_PP;
    GPIO_InitStruct.Pull = GPIO_NOPULL;
    GPIO_InitStruct.Speed = GPIO_SPEED_FREQ_HIGH;
    HAL_GPIO_Init(GPIOD, &GPIO_InitStruct);

    OLED_RST_0();
    HAL_Delay(50);
    OLED_RST_1();

    oled_write_byte(0xAE, 0); /* Display OFF */
    oled_write_byte(0x00, 0); /* Set Low Column Address */
    oled_write_byte(0x10, 0); /* Set High Column Address */
    oled_write_byte(0x40, 0); /* Set Start Line Address */
    oled_write_byte(0x81, 0); /* Set Contrast Control */
    oled_write_byte(0xCF, 0);
    oled_write_byte(0xA1, 0); /* Set Segment Re-map */
    oled_write_byte(0xC8, 0); /* Set COM Output Scan Direction */
    oled_write_byte(0xA6, 0); /* Set Normal Display */
    oled_write_byte(0xA8, 0); /* Set Multiplex Ratio */
    oled_write_byte(0x3F, 0);
    oled_write_byte(0xD3, 0); /* Set Display Offset */
    oled_write_byte(0x00, 0);
    oled_write_byte(0xD5, 0); /* Set Display Clock Divide Ratio */
    oled_write_byte(0x80, 0);
    oled_write_byte(0xD9, 0); /* Set Pre-charge Period */
    oled_write_byte(0xF1, 0);
    oled_write_byte(0xDA, 0); /* Set COM Pins Hardware Configuration */
    oled_write_byte(0x12, 0);
    oled_write_byte(0xDB, 0); /* Set VCOMH Deselect Level */
    oled_write_byte(0x40, 0);
    oled_write_byte(0x8D, 0); /* Set Charge Pump Enable */
    oled_write_byte(0x14, 0);
    oled_write_byte(0xAF, 0); /* Display ON */

    oled_clear();
}

/**
 * @brief Render 8x16 string with explicit x_offset
 */
void oled_show_string_8x16_offset(uint8_t row, uint8_t x_offset, const char *str)
{
    uint8_t x = x_offset;
    uint8_t y = row * 2; /* 8x16 font consumes 2 pages */

    uint8_t count = 0;
    while (*str && count < 16) {
        uint8_t c = *str - ' ';
        if (c > 94) c = 0;

        oled_set_pos(x, y);
        for (uint8_t i = 0; i < 8; i++) {
            oled_write_byte(g_asc2_1608[c][i], 1);
        }

        oled_set_pos(x, y + 1);
        for (uint8_t i = 0; i < 8; i++) {
            oled_write_byte(g_asc2_1608[c][i + 8], 1);
        }

        x += 8;
        str++;
        count++;
    }
}

void oled_render_page1(float battery_v, uint8_t estop_state, float left_speed, float right_speed,
                        float steer_deg, float yaw_deg, int32_t enc_left, int32_t enc_right)
{
    char buf[16];

    /* Battery + ESTOP combined onto one row (was two separate rows) - both
     * fixed-width so a value change can't leave a stray glyph behind (this
     * is what caused "9.9VV" and a leftover "D" from "ENGAGED" before):
     * %4.1f is constant width regardless of digit count, and "ENG"/"RDY"
     * are both exactly 3 characters, no padding needed either way. */
    snprintf(buf, sizeof(buf), "B:%4.1fV ES:%s", (double)battery_v, estop_state ? "ENG" : "RDY");
    oled_show_string_8x16_offset(0, 12, buf);

    /* Encoder counts, moved up from page 2 to make room there and keep
     * everything drive-related on one page. "ENC left:right" rather than
     * this page's "L:.. R:.." style below on purpose - that L/R is wheel
     * SPEED (ticks/sec), this is cumulative tick COUNT, a different
     * quantity that would look like the same thing sharing that label.
     * Width 5 on the numbers (not 4) since encoder counts can run into 5
     * digits over a session, unlike the small values below. */
    snprintf(buf, sizeof(buf), "ENC%5ld:%5ld", (long)enc_left, (long)enc_right);
    oled_show_string_8x16_offset(1, 12, buf);

    /* Display is 128px wide, this row starts at x=12, so there's only
     * 116px = 14.5 chars of room - oled_set_pos()/oled_write_byte() never
     * bounds-check x, so writing past column 127 wraps onto the next page
     * instead of erroring.
     *
     * PREVIOUS FIX WAS WRONG: %4.1f is a MINIMUM width, not a cap - it
     * never truncates, it just uses more characters when the value needs
     * them. left_speed/right_speed are tick-RATE (ticks/sec), not rad/s or
     * a small calibrated unit - at MOTOR_MAX_WHEEL_RAD_S (34.56 rad/s) that
     * back-converts to ~8580 ticks/sec, so "L:%4.1f R:%4.1f" was actually
     * 136px at realistic operating speed, worse than before that "fix".
     * Decimal precision on a value in the thousands is meaningless anyway
     * - switched to integer display, width 5 covers the full realistic
     * range including a 4-digit negative (reverse), 104px worst case. */
    snprintf(buf, sizeof(buf), "L%5.0f R%5.0f", (double)left_speed, (double)right_speed);
    oled_show_string_8x16_offset(2, 12, buf);

    /* Y = yaw, degrees - this board's own raw gyro-integrated estimate
     * (imu.c), not the Pi-side EKF's fused /odometry/filtered heading.
     * Same overflow fix as above - steer realistically stays within
     * width 3 (+/-35 max), yaw needs width 4 to safely hold 3-digit
     * swings (+180 etc) without exceeding its field. */
    snprintf(buf, sizeof(buf), "STR:%+3.0f Y:%+4.0f", (double)steer_deg, (double)yaw_deg);
    oled_show_string_8x16_offset(3, 12, buf);
}

void oled_render_page2(float us_cm, float ir_cm)
{
    char buf[16];
    char numbuf[8];

    oled_show_string_8x16_offset(0, 12, "==SENSORS====");

    /* Same fixed-width fix as page 1's battery/ESTOP lines: format the
     * number into a constant-width field first (5 chars either way) so
     * "--" doesn't leave stray glyphs behind from a previous longer
     * reading. */
    if (us_cm >= 0.0f) {
        snprintf(numbuf, sizeof(numbuf), "%5.1f", (double)us_cm);
    } else {
        snprintf(numbuf, sizeof(numbuf), "  -- ");
    }
    snprintf(buf, sizeof(buf), "Ultra:%scm", numbuf);
    oled_show_string_8x16_offset(1, 12, buf);

    /* Only one physical IR sensor is wired (ir_sensor.c), despite
     * docs/hardware.md listing two - shown once, in cm only, rather than
     * the raw ADC count and volts it used to also print alongside it. */
    snprintf(buf, sizeof(buf), "IR:   %5.1fcm", (double)ir_cm);
    oled_show_string_8x16_offset(2, 12, buf);
}

void oled_render_page3(float gyro_x, float gyro_y, float gyro_z)
{
    char buf[16];

    oled_show_string_8x16_offset(0, 12, "==GYRO dps===");

    /* deg/s, bias-corrected + unit-scaled (imu.c) but NOT further filtered -
     * this is what the Pi-side EKF actually fuses (Z only, see ekf.yaml).
     * One axis per row - three floats with labels do not fit on one 116px
     * row at any useful precision. */
    snprintf(buf, sizeof(buf), "X:%+7.2f", (double)gyro_x);
    oled_show_string_8x16_offset(1, 12, buf);

    snprintf(buf, sizeof(buf), "Y:%+7.2f", (double)gyro_y);
    oled_show_string_8x16_offset(2, 12, buf);

    snprintf(buf, sizeof(buf), "Z:%+7.2f", (double)gyro_z);
    oled_show_string_8x16_offset(3, 12, buf);
}

void oled_render_page4(float accel_x, float accel_y, float accel_z)
{
    char buf[16];

    oled_show_string_8x16_offset(0, 12, "==ACCEL m/s2=");

    /* Raw ADC x fixed scale ONLY - unlike gyro, there is no bias
     * calibration applied to accel at all (see imu.c). Robot flat and
     * still should read ~9.81 on whichever axis is vertical, ~0 on the
     * other two - useful sanity check for whether the IMU is mounted the
     * orientation the firmware assumes (no axis remap applied anywhere). */
    snprintf(buf, sizeof(buf), "X:%+6.2f", (double)accel_x);
    oled_show_string_8x16_offset(1, 12, buf);

    snprintf(buf, sizeof(buf), "Y:%+6.2f", (double)accel_y);
    oled_show_string_8x16_offset(2, 12, buf);

    snprintf(buf, sizeof(buf), "Z:%+6.2f", (double)accel_z);
    oled_show_string_8x16_offset(3, 12, buf);
}

void oled_render_page5(uint16_t pwm_us, uint16_t pwm_center_us, float steer_deg)
{
    char buf[16];

    oled_show_string_8x16_offset(0, 12, "==STEERING===");

    /* Actual pulse width read back from TIM12_CH2's compare register
     * (servo_get_pulse_us()) - what the servo is ACTUALLY being sent, not
     * just what was last commanded. */
    snprintf(buf, sizeof(buf), "PWM: %4uus", pwm_us);
    oled_show_string_8x16_offset(1, 12, buf);

    /* The calibrated center (servo_pulse_center_us(), currently 1490us) -
     * shown alongside PWM so a center-trim check doesn't need ROS/a
     * laptop, just watch this while at angle 0. */
    snprintf(buf, sizeof(buf), "CTR: %4uus", pwm_center_us);
    oled_show_string_8x16_offset(2, 12, buf);

    snprintf(buf, sizeof(buf), "ANGLE:%+4.0f", (double)steer_deg);
    oled_show_string_8x16_offset(3, 12, buf);
}

void oled_next_page(void)
{
    g_oled_page = (g_oled_page + 1) % 5; /* Loop through 5 pages */
    oled_clear();
}
